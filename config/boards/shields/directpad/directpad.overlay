#include <dt-bindings/led/led.h>
#include <dt-bindings/zmk/matrix_transform.h>

/ {
    chosen {
        zmk,kscan = &kscan0;
		zmk,matrix_transform = &default_transform;
    };

    default_transform: keymap_transform_0 {
		compatible = "zmk,matrix-transform";
		columns = <4>;
		rows = <1>;
		map = <
		       RC(0,0) 	RC(0,1)  RC(0,2)  RC(0,3)
		>;
	};


    kscan0: kscan {
        compatible = "zmk,kscan-gpio-direct";
        label = "KSCAN";
        input-gpios
            = <&pro_micro 10  (GPIO_ACTIVE_LOW | GPIO_PULL_UP)>
			, <&pro_micro 16  (GPIO_ACTIVE_LOW | GPIO_PULL_UP)>
			, <&pro_micro 14  (GPIO_ACTIVE_LOW | GPIO_PULL_UP)>
			, <&pro_micro 15  (GPIO_ACTIVE_LOW | GPIO_PULL_UP)>
			;
    };

//    encoder: encoder {
//		compatible = "alps,ec11";
//		label = "ENCODER";
//		a-gpios = <&pro_micro 1 (GPIO_ACTIVE_HIGH | GPIO_PULL_UP)>;
//		b-gpios = <&pro_micro 0 (GPIO_ACTIVE_HIGH | GPIO_PULL_UP)>;
//		resolution = <4>;
//	};
//
//    sensors {
//        compatible = "zmk,keymap-sensors";
//        sensors = <&encoder>;
//    };
//	&encoder {
//		status = "okay";
